## drivers/mtd/spi-nor/Kconfig
```kconfig
# SPDX-License-Identifier: GPL-2.0-only
menuconfig MTD_SPI_NOR
	tristate "SPI NOR device support"
	depends on MTD
	depends on MTD && SPI_MASTER
	select SPI_MEM
	help
	  This is the framework for the SPI NOR which can be used by the SPI
	  device drivers and the SPI NOR device driver.

if MTD_SPI_NOR

config M25PXX_STAY_IN_3BYTE_MODE
       bool "Stay in 3-byte address mode when idle"
       default n
       help
         This option forces the flash to stay in 3-byte address mode when idle
         (even for flashes that require 4-byte address). This is work around the
         reset problem if the controller cannot issue 4-byte OPCODE when booting.

config MTD_MT81xx_NOR
	tristate "Mediatek MT81xx SPI NOR flash controller"
	depends on HAS_IOMEM
	help
	  This enables access to SPI NOR flash, using MT81xx SPI NOR flash
	  controller. This controller does not support generic SPI BUS, it only
	  supports SPI NOR Flash.

config MTD_SPI_NOR_USE_4K_SECTORS
	bool "Use small 4096 B erase sectors"
	default y
	help
	  Many flash memories support erasing small (4096 B) sectors. Depending
	  on the usage this feature may provide performance gain in comparison
	  to erasing whole blocks (32/64 KiB).
	  Changing a small part of the flash's contents is usually faster with
	  small sectors. On the other hand erasing should be faster when using
	  64 KiB block instead of 16 × 4 KiB sectors.

	  Please note that some tools/drivers/filesystems may not work with
	  4096 B erase size (e.g. UBIFS requires 15 KiB as a minimum).

source "drivers/mtd/spi-nor/controllers/Kconfig"

endif # MTD_SPI_NOR

menuconfig MTD_SPI_NOR_IPROC
       tristate "BRCM IPROC SPI-NOR device support"
       depends on MTD
       help
         This is the framework for the SPI NOR which can be used by the SPI
         device drivers and the SPI-NOR device driver.

if MTD_SPI_NOR_IPROC

config M25PXX_STAY_IN_3BYTE_MODE
       bool "Stay in 3-byte address mode when idle"
       default n
       help
         This option forces the flash to stay in 3-byte address mode when idle
         (even for flashes that require 4-byte address). This is work around the
         reset problem if the controller cannot issue 4-byte OPCODE when booting.

config MTD_SPI_NOR_USE_4K_SECTORS
       bool "Use small 4096 B erase sectors"
       default n
       help
         Many flash memories support erasing small (4096 B) sectors. Depending
         on the usage this feature may provide performance gain in comparison
         to erasing whole blocks (32/64 KiB).
         Changing a small part of the flash's contents is usually faster with
         small sectors. On the other hand erasing should be faster when using
         64 KiB block instead of 16 × 4 KiB sectors.

         Please note that some tools/drivers/filesystems may not work with
         4096 B erase size (e.g. UBIFS requires 15 KiB as a minimum).

endif # MTD_SPI_NOR_IPROC
```
